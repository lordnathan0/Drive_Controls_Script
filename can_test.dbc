VERSION "HIPBNYYYYYYYYYYYYYYYYYYYYYYYYYYYYYYYYYYYYY/4/%%%/4/'%**4YYY///"

NS_ :

BS_:

BU_:

BO_ 401 Throttle: 8 Vector__XXX
 SG_ RPM : 0|32@1+ (1,0) [0|0] "" Vector__XXX
 SG_ Current : 32|32@1- (1,0) [0|0] "" Vector__XXX

SIG_VALTYPE_ 401 Current : 1;
